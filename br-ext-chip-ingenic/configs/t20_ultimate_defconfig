## br-ext-chip-ingenic/configs/t20_ultimate_defconfig
```kconfig
# --- OpenIPC T20: USB + Opkg (Без Motion) ---

BR2_PACKAGE_BUSYBOX=y
BR2_PACKAGE_LIBC=y
BR2_PACKAGE_DROPBEAR=y
BR2_PACKAGE_MAJESTIC=y
BR2_PACKAGE_MAJESTIC_WEBUI=y
BR2_PACKAGE_MAJESTIC_FONTS=y

BR2_PACKAGE_OPKG=y
BR2_PACKAGE_RTL8189FS_OPENIPC=y

BR2_PACKAGE_E2FSPROGS=y
BR2_PACKAGE_DOSFSTOOLS=y
BR2_PACKAGE_MOUNT=y
BR2_PACKAGE_BLOCK_MOUNT=y

# BR2_PACKAGE_QUIRC_OPENIPC is not set
# BR2_PACKAGE_ZEROTIER_ONE is not set
# BR2_PACKAGE_WIREGUARD is not set
# BR2_PACKAGE_VTUN is not set
# BR2_PACKAGE_IWINFO is not set
# BR2_PACKAGE_LIBIWINFO is not set
# BR2_PACKAGE_QRSCAN is not set
# BR2_PACKAGE_TELEMETRY is not set

# BR2_PACKAGE_RTL8188EUS_OPENIPC is not set
# BR2_PACKAGE_RTL8188FU_OPENIPC is not set
# BR2_PACKAGE_RTL8189ES_OPENIPC is not set
# BR2_PACKAGE_RTL8192EU_OPENIPC is not set
# BR2_PACKAGE_RTL8733BU_OPENIPC is not set
# BR2_PACKAGE_RTL8812AU_OPENIPC is not set
# BR2_PACKAGE_MT7601U_OPENIPC is not set
# BR2_PACKAGE_AIC8800_OPENIPC is not set
# BR2_PACKAGE_ATBM60XX is not set
# BR2_PACKAGE_SSV6X5X_OPENIPC is not set
# BR2_PACKAGE_SSW101B is not set
```
